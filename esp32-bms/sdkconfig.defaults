## esp32-bms/sdkconfig.defaults
```kconfig
CONFIG_BT_NIMBLE_ENABLED=y
CONFIG_BT_BLUEDROID_ENABLED=n

CONFIG_BT_NIMBLE_ROLE_OBSERVER=y
CONFIG_BT_NIMBLE_ROLE_CENTRAL=y
CONFIG_BT_NIMBLE_ROLE_PERIPHERAL=n
CONFIG_BT_NIMBLE_ROLE_BROADCASTER=n

CONFIG_BT_NIMBLE_MAX_CONNECTIONS=1

CONFIG_SW_COEXIST_ENABLE=y
CONFIG_ESP_WIFI_SW_COEXIST_ENABLE=y

CONFIG_ESP_TASK_WDT_TIMEOUT_S=15

CONFIG_BT_NIMBLE_LOG_LEVEL=2
```
